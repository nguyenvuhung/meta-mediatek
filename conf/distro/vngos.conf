## conf/distro/vngos.conf
```bitbake
include conf/distro/poky.conf

# This is VyOS for OpenEmbedded
DISTRO = "vngos"
DISTRO_NAME = "VNGOS-Linux"
DISTRO_VERSION = "1.0"
DISTRO_CODENAME = "hungnv9"
SDK_VENDOR = "-vng-sdk"
SDK_VERSION="${DISTRO_VERSION}"
MAINTAINER = "hungnv9@vng.com.vn"

TARGET_VENDOR = "-vngos"
# Override these in poky based distros
VNGOS_DEFAULT_DISTRO_FEATURES = "largefile opengl ptest multiarch wayland vulkan"
VNGOS_DEFAULT_EXTRA_RDEPENDS = "packagegroup-core-boot"
VNGOS_DEFAULT_EXTRA_RRECOMMENDS = "kernel-module-af-packet"

DISTRO_EXTRA_RDEPENDS += " ${VNGOS_DEFAULT_EXTRA_RDEPENDS}"
DISTRO_EXTRA_RRECOMMENDS += " ${VNGOS_DEFAULT_EXTRA_RRECOMMENDS}"

DISTRO_FEATURES ?= "${VNGOS_DEFAULT_DISTRO_FEATURES} ${DISTRO_FEATURES_LIBC} "

#PACKAGE_CLASSES = "package_ipk"

# This layer contains kernel patches for a variety of machine-specific
# kernels using .bbappend files in recipes-kernel/linux. To allow image
# building without all machine layers being present, we turn 'dangling
# .bbappend file' errors into warnings
BB_DANGLINGAPPENDS_WARNONLY = "1"

# we install dpkg anyways, might as well use .deb packages instead of the
# default .ipk
#PACKAGE_CLASSES = "package_deb"

# VyOS configuration requires fuse filesystem to work, so autoload module on
# system bootup
KERNEL_MODULE_AUTOLOAD += " fuse"


# VyOS shall use systemd
VIRTUAL-RUNTIME_init_manager = "systemd"
#DISTRO_FEATURES_BACKFILL_CONSIDERED = "sysvinit"
#VIRTUAL-RUNTIME_initscripts = "systemd-compat-units"
DISTRO_FEATURES_append = " systemd"


DISTRO_FEATURES_append = " \
    pam \
    vyos-net \
    vyos-routing \
    vyos-wwan \
    vyos-dhcp \
    vyos-debug \
    "

DISTRO_FEATURES_append = " \
    vyos-swupdate \
    "
```
